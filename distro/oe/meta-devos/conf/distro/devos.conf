## distro/oe/meta-devos/conf/layer.conf
```bitbake
BBPATH .= ":${LAYERDIR}"
BBFILES += "${LAYERDIR}/recipes-*/*/*.bb ${LAYERDIR}/recipes-*/*/*.bbappend"
BBFILE_COLLECTIONS += "devos"
BBFILE_PATTERN_devos = "^${LAYERDIR}/"
BBFILE_PRIORITY_devos = "10"
LAYERSERIES_COMPAT_devos = "wrynose"
LAYERDEPENDS_devos = "core openembedded-layer gnome-layer networking-layer meta-python multimedia-layer wayland"
```
